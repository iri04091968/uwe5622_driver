## Kconfig
```kconfig
config SPARD_WLAN_SUPPORT
	bool "Unisoc wireless Support"
	select RK_WIFI_DEVICE_UWE5622  if SPARD_WLAN_SUPPORT
	default n
	help
	  This is support for spreadtrum wireless chip.

if SPARD_WLAN_SUPPORT
source "drivers/net/wireless/uwe5622/unisocwifi/Kconfig"
endif
```
